## Kconfig
```kconfig
###############################################################################
# SPDX-License-Identifier: GPL-3.0-or-later
###############################################################################

mainmenu "Make Project"

# Board Seelct Section
menu "Select Board Menu"
    source "board/Kconfig"
endmenu

# Select Core architecture
menu "Select Core Menu"
    source "CMSIS/Kconfig"
endmenu

# Driver Selection Section
menu "Select Driver Menu"
    source "driver/Kconfig"
endmenu

# lwIP or FatFS Selection Section
menu "Select Library Menu"
    source "Library/Kconfig"
endmenu

# FreeRTOS Selection Section
menu "Select FreeRTOS Menu"
    source "kernel/Kconfig"
endmenu

# Study Code Chapter Select
menu "Select Sample Study Chapter Menu"
    source "StudyProject/Kconfig"
endmenu

# module Test Project Select
menu "Select Module Sample Test Menu"
    source "moduleTestCode/Kconfig"
endmenu

###############################################################################
```

## Library/Kconfig
```kconfig
###############################################################################
# SPDX-License-Identifier: GPL-3.0-or-later
###############################################################################

menu "Select Extra Library Select Menu"
    source "Library/extraLib/Kconfig"
endmenu

menu "Select Middle Ware Select Menu"
    source "Library/middleWare/Kconfig"
endmenu

menu "Select module Lbrary Select Menu"
    source "Library/module/Kconfig"
endmenu

###############################################################################
```

## Library/extraLib/Kconfig
```kconfig
###############################################################################
# SPDX-License-Identifier: GPL-3.0-or-later
###############################################################################

config USB_FS_DEVICE_DRIVER
    bool "USB FS Device Driver Select"
    default n
    select EXTRA_LIB

config CC2520
    bool "cc2520 Library Select"
    default n
    select EXTRA_LIB

config EDU_CLCD
    bool "edu board LCD Library Select"
    default n
    select EXTRA_LIB

###############################################################################
```

## Library/middleWare/Kconfig
```kconfig
###############################################################################
# SPDX-License-Identifier: GPL-3.0-or-later
###############################################################################

config LWIP
    bool "Select lwIp Select"
    default n

###############################################################################
```

## Library/module/Kconfig
```kconfig
###############################################################################
# SPDX-License-Identifier: GPL-3.0-or-later
###############################################################################

config ESP8266
    bool "Select ESP8266 Module Library"
    default n



###############################################################################
```

## StudyProject/Edu_Board/Kconfig
```kconfig
###############################################################################
# SPDX-License-Identifier: GPL-3.0-or-later
###############################################################################

config GPIO_TEST_EDU
    bool "01.GPIO Test Select Using HAL Driver"
    default n
    select HAL_DRIVER
    select EDU_BOARD

config UART_POLLING_EDU
    bool "02.UART polling Mode Test Select Using HAL Driver "
    default n
    select HAL_DRIVER
    select EDU_BOARD

config UART_PRINTF_EDU
    bool "03.UART Printf Test Select Using HAL Driver"
    default n
    select HAL_DRIVER
    select EDU_BOARD

config UART_INTERRUPT_EDU
    bool "04.UART Interrupt Test Select Using HAL Driver"
    default n
    select HAL_DRIVER
    select EDU_BOARD

config LCD_PRINT_EDU
    bool "05.LCD Moudle print Test Select Using HAL Driver"
    default n
    select HAL_DRIVER
    select EDU_BOARD
    select EDU_CLCD


config TIM_INTERRUPT_EDU
    bool "06.TIM-Interrupt Timer Test Select Using HAL Driver"
    default n
    select HAL_DRIVER
    select EDU_BOARD
    select EDU_CLCD



###############################################################################
```

## StudyProject/Kconfig
```kconfig
###############################################################################
# SPDX-License-Identifier: GPL-3.0-or-later
###############################################################################

# menu "Study Sample Chapter Project Mstory2.0"
#     source "StudyProject/Mstory2.0/Kconfig"
# endmenu

# menu "Study Sample Chapter Project Mstory3.0"
#     source "StudyProject/Mstory3.0/Kconfig"
# endmenu

menu "Study Sample Chapter Project EDU-Board"
    source "StudyProject/Edu_Board/Kconfig"
endmenu

menu "Module Test Code Project"
    source "StudyProject/moduleTest/Kconfig"
endmenu

###############################################################################
```

## StudyProject/MStory2.0/Kconfig
```kconfig
###############################################################################
# SPDX-License-Identifier: GPL-3.0-or-later
###############################################################################


menu "Mango M-3 Board Sample Chapter MStory2.0"
    source "StudyProject/MStory2.0/MANGO-M3/Kconfig"
endmenu

menu "Mango Z-1 Board Sample Chapter MStroy2.0"
    source "StudyProject/MStory2.0/MANGO-Z1/Kconfig"
endmenu

###############################################################################
```

## StudyProject/MStory2.0/MANGO-M3/Kconfig
```kconfig
###############################################################################
# SPDX-License-Identifier: GPL-3.0-or-later
###############################################################################



config MSTORY_V2_0_SRC_LED_1
    bool "MStory Version 2.0 Chapter LED ON OFF First Test "
    default n

config MSTORY_V2_0_SRC_LED_2
    bool "MStory Version 2.0 Chapter LED ON OFF GPIO RESET SET Use"
    default n

config MSTORY_V2_0_SRC_LED_3
    bool "MStory Version 2.0 Chapter LED OFF GPIO SET Use"
    default n

config MSTORY_V2_0_SRC_LED_4
    bool "MStory Version 2.0 Chapter LED ON OFF ALL SET RESET Use"
    default n

config MSTORY_V2_0_SRC_LED_5
    bool "MStory Version 2.0 Chapter LED ON OFF ALL Chnage coding style"
    default n

config MSTORY_V2_0_SRC_LED_6
    bool "MStory Version 2.0 Chapter LED ON OFF ALL Change coding style version 2"
    default n

config MSTORY_V2_0_SRC_KEY_PRESS
    bool "MStory Version 2.0 Chapter KEY PRESS "
    default n

config MSTORY_V2_0_SRC_HELLO_WORLD
    bool "MStory Version 2.0 Chapter Hello World 1"
    default n

config MSTORY_V2_0_SRC_HELLO_WORLD_TWO
    bool "MStory Version 2.0 Chapter Hello World 2"
    default n

config MSTORY_V2_0_SRC_GETCHAR
    bool "MStory Version 2.0 Chapter Get Char "
    default n

config MSTORY_V2_0_SRC_SEVEN_SEGMENT
    bool "MStory Version 2.0 Chapter 7 Segment"
    default n

config MSTORY_V2_0_SRC_CLOCK_SYSTEM
    bool "MStory Version 2.0 Chapter clock system"
    default n

config MSTORY_V2_0_SRC_CLOCK_SYSTEM2
    bool "MStory Version 2.0 Chapter clock system2"
    default n

config MSTORY_V2_0_SRC_SYSCLOCK
    bool "MStory Version 2.0 Chapter sys clock perfect 1 second delay"
    default n

config MSTORY_V2_0_SRC_EXTI
    bool "MStory Versoin 2.0 Chapter EXTI Interrupt"
    default n

    
###############################################################################
```

## StudyProject/MStory2.0/MANGO-Z1/Kconfig
```kconfig
###############################################################################
# SPDX-License-Identifier: GPL-3.0-or-later
###############################################################################


config CMSIS_SAMPLE_HELLO_WORLD_Z1
    bool "CMSIS Standard driver Start Sample Z1"
    default n
    select STANDARD_DRIVER

config CMSIS_LED_KEY_CONTROL
    bool "CMSIS Standard Driver LED KEY Control Z1"
    default n
    select STANDARD_DRIVER
    
config CMSIS_CLOCK_CONTROL
    bool "CMSIS Standard Driver Clock Control Z1"
    default n
    select STANDARD_DRIVER

config CMSIS_KEY_INTERRUPT
    bool "CMSIS Standard Driver key interrupt push button Z1"
    default n
    select STANDARD_DRIVER

config CMSIS_IAP_BOOTLOADER
    bool "CMSIS Standard Driver use IAP Boot Loader"
    default n
    select STANDARD_DRIVER

config CMSIS_SPI_TEST
    bool "CMSIS Standard Driver Testing CC2520 zigbee chip(use mango-z1 board)"
    default n
    select STANDARD_DRIVER
    select CC2520
    select MANGO_Z1

config CMSIS_ZIGBEE_RX_TX_ONE_TEST
    bool "CMSIS Standard Driver Testing CC2520 zigbee one byte rx tx test"
    default n
    select STANDARD_DRIVER
    select CC2520
    select MANGO_Z1

config CMSIS_ONE_BYTE_RX_TX_TEST
    bool "CMSIS Standard Driver Testing Multi Packet Transmit Rx Tx Test"
    default n
    select STANDARD_DRIVER
    select CC2520
    select MANGO_Z1
    
config CMSIS_USB_HID_TEST
    bool "CMSIS Standard Driver Testing USB.HID "
    default n
    select STANDARD_DRIVER
    select CC2520
    select USB_HID
    select USB_FS_DEVICE_DRIVER
    select MANGO_Z1

###############################################################################
```

## StudyProject/MStory3.0/Kconfig
```kconfig
###############################################################################
# SPDX-License-Identifier: GPL-3.0-or-later
###############################################################################

config MSTORY_V3_0_SRC_LIB_DEBUG
    bool "MStory Version 3.0 Chapter Lib DEBUG"
    select STANDARD_DRIVER
    select CC2520
    select USB_HID
    select USB_FS_DEVICE_DRIVER
    default n

config MSTORY_V3_0_SRC_BIT_BAND
    bool "MStory Version 3.0 Chapter Bit_Band"
    select STANDARD_DRIVER
    select CC2520
    select USB_HID
    select USB_FS_DEVICE_DRIVER
    default n

config MSTORY_V3_0_SRC_MODE_PRIVILEGE
    bool "MStory Version 3.0 Chapter Mode Privilege"
    select STANDARD_DRIVER
    select CC2520
    select USB_HID
    select USB_FS_DEVICE_DRIVER
    default n

config MSTORY_V3_0_SRC_BASEPROGRAM_FORDFU
    bool "MStory Version 3.0 Chapter Base programing for DFU"
    select STANDARD_DRIVER
    select CC2520
    select USB_FS_DEVICE_DRIVER
    select USB_HID
    default n

###############################################################################
```

## board/Kconfig
```kconfig
###############################################################################
# SPDX-License-Identifier: GPL-3.0-or-later
###############################################################################

config MANGO_M3
    bool "Select mango-m3 Board"
    default n
    select ARCH_M3

config MANGO_Z1
    bool "Select mango-z1 Board"
    default n
    select ARCH_M3

config MANGO_M32F2
    bool "Select mango-m32F2 Board"
    default n
    select ARCH_M3

config MANGO_M4
    bool "Select mango-m4 Board"
    default n
    select ARCH_M4

config EDU_BOARD
    bool "Select EDU-M4 Board"
    default n
    select ARCH_M4


###############################################################################
```

## kernel/Kconfig
```kconfig
###############################################################################
# SPDX-License-Identifier: GPL-3.0-or-later
###############################################################################


menuconfig FREE_RTOS
	bool "FreeRTOS Support"
	default n


if FREE_RTOS

config FreeRTOS_V5 
	bool "FreeRTOS Version v5.4.2"
    default n

config FreeRTOS_V10
	bool "FreeRTOS Version v10.2"
    default n



config FREERTOS_VERSION
    string
        default "freeRTOS_v5" if FreeRTOS_V5 && y

config FREERTOS_VERSION
    string
        default "FreeRTOS_v10" if FreeRTOS_V10 && y



endif   # if FreeRTOS

###############################################################################
```

## moduleTestCode/Kconfig
```kconfig
###############################################################################
# SPDX-License-Identifier: GPL-3.0-or-later
###############################################################################

config ESP_12E
 bool "ESP8266-12E Test"
 default n


###############################################################################
```
