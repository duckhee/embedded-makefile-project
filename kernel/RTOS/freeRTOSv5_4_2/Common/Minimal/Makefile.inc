###########################################################
# GCC template makefile
###########################################################

FREERTOS_MINIMAL_SOURCES = 
FREERTOS_MINIMAL_SOURCES += AltBlckQ.c
FREERTOS_MINIMAL_SOURCES += AltBlock.c
FREERTOS_MINIMAL_SOURCES += AltPollQ.c
FREERTOS_MINIMAL_SOURCES += AltQTest.c
FREERTOS_MINIMAL_SOURCES += BlockQ.c
FREERTOS_MINIMAL_SOURCES += blocktim.c
FREERTOS_MINIMAL_SOURCES += comtest.c
FREERTOS_MINIMAL_SOURCES += countsem.c
FREERTOS_MINIMAL_SOURCES += crflash.c
FREERTOS_MINIMAL_SOURCES += crhook.c
FREERTOS_MINIMAL_SOURCES += death.c
FREERTOS_MINIMAL_SOURCES += dynamic.c
#FREERTOS_MINIMAL_SOURCES += flash.c
FREERTOS_MINIMAL_SOURCES += flop.c
FREERTOS_MINIMAL_SOURCES += GenQTest.c
FREERTOS_MINIMAL_SOURCES += integer.c
#FREERTOS_MINIMAL_SOURCES += IntQueue.c
FREERTOS_MINIMAL_SOURCES += PollQ.c
FREERTOS_MINIMAL_SOURCES += QPeek.c
FREERTOS_MINIMAL_SOURCES += recmutex.c
FREERTOS_MINIMAL_SOURCES += semtest.c

C_SOURCES += $(FREERTOS_MINIMAL_SOURCES)
